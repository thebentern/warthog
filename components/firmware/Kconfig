## components/firmware/Kconfig
```kconfig
# Copyright 2024-2026 Morse Micro
# SPDX-License-Identifier: Apache-2.0
menu "Morse Micro Firmware Configuration"
    config MM_BCF_FILE
        string "Morse Micro Board Configuration File"
        default "bcf_fgh100mhaamd.mbin"
        help
            Set the name of the BCF (Board Configuration File) to use.
            Example valid filenames include:
              - bcf_mf08651_us.mbin
              - bcf_mf08551.mbin
              - bcf_mf08251.mbin
              - bcf_mf03120.mbin

            This file provides board-specific configuration data for the Morse Micro chip/module.

            The build system will search for the specified file in the following locations:
              1. firmware/ in the root of the application being built

            If the file is not found in either location, a warning will be reported during
            configuration.

    config MM_FW_FILE
        string "Morse Micro Firmware File"
        default "mm6108.mbin"
        help
            This is the firmware file for the Morse Micro chip/module.

            The build system will search for the specified file in the following locations:
              1. firmware/ in the root of the application being built

            If the file is not found in either location, a warning will be reported during
            configuration.

    choice MMHAL_CHIP_TYPE
        bool "Morse Micro Chip Variant"
        default MMHAL_CHIP_TYPE_MM6108
        help
            This specifies which chip function ops should be used by morselib.

        config MMHAL_CHIP_TYPE_MM6108
            bool "mmhal_mm6108"
        config MMHAL_CHIP_TYPE_MM8108
            bool "mmhal_mm8108"
    endchoice

endmenu
```

## components/halow/Kconfig
```kconfig
# Copyright 2025-2026 Morse Micro
# SPDX-License-Identifier: Apache-2.0

rsource "components/firmware/Kconfig"
rsource "components/mmpktmem/Kconfig"
rsource "components/shims/Kconfig"
rsource "components/regdb/Kconfig"

menu "Wi-Fi HaLow Connection Manager"

    config WIFI_HALOW
        bool "Enable Morse Micro Wi-Fi HaLow support"
        default y
        select MBEDTLS_NIST_KW_C

    config WARTHOG_HW_REGIONS
        string "Countries this module's RF front end and BCF are qualified for"
        default "US"
        help
            Comma list of two-letter codes; AT+REGION offers those also in the regdb and the BCF.

    config WARTHOG_HW_BAND_LO_KHZ
        int "Lowest frequency the module is rated for (kHz)"
        default 902000

    config WARTHOG_HW_BAND_HI_KHZ
        int "Highest frequency the module is rated for (kHz)"
        default 928000

	config HALOW_PS_MODE
		bool "Enable Morse Micro HaLow Powersave Mode"
		default true
		depends on MM_WAKE >= 0
		depends on MM_BUSY >= 0
		help
			This can only be set to true for devices which have the BUSY and WAKE
			pins connected.

    config HALOW_AP_MODE
        bool "Enable HaLow AP-mode support"
        default n
        help
            Adds requisite components for AP-mode viathe HaLow interface. This
            is disabled by default due to the extra functionality increasing the
            flash and ram requirements by a non inconsequential amount.

endmenu
```

## components/halow/components/firmware/Kconfig
```kconfig
# Copyright 2024-2026 Morse Micro
# SPDX-License-Identifier: Apache-2.0
menu "Morse Micro Firmware Configuration"
    config MM_BCF_FILE
        string "Morse Micro Board Configuration File"
        help
            Set the name of or relative path to the BCF (Board Configuration File).

            Only the filename is required; the bcf directory of the morse-firmware
            submodule is searched recursively, so vendor subdirectories do not need
            to be specified.

            .bin files are converted to .mbin (based on file extension). A .mbin may
            be requested even when only the .bin source is shipped: the .bin is then
            located and run through the conversion automatically.

            Example valid filenames include:
              - bcf_mf08651_us.bin
              - bcf_mf15457.bin
              - bcf_fgh100mhaamd.mbin
              - bcf_aw_hm593.mbin

            This file provides board-specific configuration data for the Morse Micro chip/module.

            The build system will search for the specified file in the following locations:
              1. the relative path from the project root
              2. recursively within the morse-firmware submodule's bcf directory

            If a file is not found, an error will be thrown when building.

    choice MM_CHIP
        bool "Morse Micro Chip Variant"
        optional
        help
            This is used for selecting HAL calls and selecting firmware.

        config MM_CHIP_MM6108
            bool "Morse Micro mm6108"
        config MM_CHIP_MM8108
            bool "Morse Micro mm8108"
    endchoice

endmenu
```

## components/halow_mesh_compat/Kconfig
```kconfig
menu "Warthog halow_mesh_compat (Linux driver port)"

config WARTHOG_MESH_COMPAT
    bool "Enable Linux morse_driver port for mesh"
    default n
    help
      Enables the Linux GPL morse_driver compatibility layer that provides
      mesh-capable host-side driving of the MM6108 chip. Gated by default
      because:
        - License (GPL-2.0+) propagates to the firmware binary
        - Currently scaffold-only; needs Morse Micro to deliver a
          mesh-capable MMFW firmware before the port can complete
      See components/halow_mesh_compat/README.md for status.

config WARTHOG_MESH_COMPAT_DEBUG
    bool "Verbose logging in mesh compat layer"
    depends on WARTHOG_MESH_COMPAT
    default n
    help
      Routes the ported driver's pr_debug / dot11ah_dbg / MORSE_INFO
      logging through ESP_LOGI. Voluminous; only enable for bring-up.

endmenu
```
